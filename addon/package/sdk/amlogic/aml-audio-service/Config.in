## addon/package/sdk/amlogic/aml-audio-service/Config.in
```kconfig
config BR2_PACKAGE_AML_AUDIO_SERVICE
    bool "aml-audio-service"
    select BR2_PACKAGE_GRPC
    select BR2_PACKAGE_AML_AMAUDIOUTILS
    select BR2_PACKAGE_DOLBY_MS12
    select BR2_PACKAGE_BOOST
    select BR2_PACKAGE_BOOST_SYSTEM
```

## addon/package/sdk/amlogic/aml-mali/Config.in
```kconfig
config BR2_PACKAGE_AML_MALI
	bool "aml-mali"
	depends on BR2_arm
	select BR2_PACKAGE_HAS_LIBEGL
	select BR2_PACKAGE_HAS_LIBGLES
	select BR2_PACKAGE_HAS_LIBGBM
	select BR2_PACKAGE_LIBDRM
	help
	  MALI driver platform

comment "mali needs BR2_arm"
	depends on !BR2_arm

if BR2_PACKAGE_AML_MALI

config BR2_PACKAGE_PROVIDES_LIBEGL
    string
	default "aml-mali"

config BR2_PACKAGE_PROVIDES_LIBGBM
    string
	default "aml-mali"

config BR2_PACKAGE_PROVIDES_LIBGLES
    string
	default "aml-mali"

config BR2_PACKAGE_SDK_INSTALL
    string
	default "aml-mali"

endif
```

## addon/package/sdk/amlogic/aml-media-driver/Config.in
```kconfig
config BR2_PACKAGE_AML_MEDIA_DRIVER
	bool "aml-media-driver"
	depends on BR2_arm
	help
	  BSP for Media AMLogic TV platform

comment "platco-tv-bsp needs BR2_arm"
	depends on !BR2_arm
```

## addon/package/sdk/amlogic/aml-optee-driver/Config.in
```kconfig
config BR2_PACKAGE_AML_OPTEE_DRIVER
	bool "aml-optee-driver"
	depends on BR2_arm
	help
	  BSP for AMLogic OPTEE platform

comment "aml-optee-driver needs BR2_arm"
	depends on !BR2_arm
```

## addon/package/sdk/platco-tv-sdk/Config.in
```kconfig
config BR2_PACKAGE_PLATCO_TV_BSP
	bool "platco-tv-bsp"
	depends on BR2_arm
	select BR2_PACKAGE_HAS_LIBEGL
	select BR2_PACKAGE_HAS_LIBGLES
	select BR2_PACKAGE_HAS_LIBGBM
	select BR2_PACKAGE_LIBDRM
	help
	  BSP for Platco TV platform

comment "platco-tv-bsp needs BR2_arm"
	depends on !BR2_arm

if BR2_PACKAGE_PLATCO_TV_BSP

config BR2_PACKAGE_PROVIDES_LIBEGL
	default "platco-tv-bsp"

config BR2_PACKAGE_PROVIDES_LIBGBM
	default "platco-tv-bsp"

config BR2_PACKAGE_PROVIDES_LIBGLES
	default "platco-tv-bsp"

config BR2_PACKAGE_SDK_INSTALL
    string
	default "platco-tv-bsp"

endif
```

## addon/package/sipeed-lpi4abin/Config.in
```kconfig
config BR2_PACKAGE_SIPEED_LPI4ABIN
    bool "sipeed-lpi4abin"
    depends on BR2_riscv=y
    help
      This package provides TH1520 SoC binary blobs for LicheePi 4A.
```

## addon/package/whisper/Config.in
```kconfig
config BR2_PACKAGE_WHISPER
	bool "whisper"
        depends on BR2_GCC_ENABLE_OPENMP
        select BR2_PACKAGE_LLAMA
        select BR2_PACKAGE_GGML

comment "whisper needs a toolchain with OpenMP support"
        depends on !BR2_GCC_ENABLE_OPENMP
```

## addon/package/wpebackend/Config.in
```kconfig
config BR2_PACKAGE_WPEBACKEND_LIBWPE_VERSION
        string
        default "1.6.0" if BR2_PACKAGE_WPEWEBKIT_ML_2_28
        default "1.14.0" if BR2_PACKAGE_WPEWEBKIT_ML_2_38

config BR2_PACKAGE_WPEBACKEND
        bool "wpebackend"
        depends on !BR2_STATIC_LIBS # dlfcn.h
        depends on BR2_INSTALL_LIBSTDCPP
        depends on BR2_PACKAGE_HAS_LIBEGL
        select BR2_PACKAGE_LIBXKBCOMMON
        help
          Base library for the WPE port of WebKit.

          https://wpewebkit.org/
```

## addon/package/wpeframework-opensource/Config.in
```kconfig
source "$BR2_EXTERNAL_ADDON_PACKAGES_PATH/package/wpeframework-opensource/wpeframework/Config.in"

menu "WPEFramework Plugins"
source "$BR2_EXTERNAL_ADDON_PACKAGES_PATH/package/wpeframework-opensource/wpeframework-plugins/Config.in"
source "$BR2_EXTERNAL_ADDON_PACKAGES_PATH/package/wpeframework-opensource/wpeframework-launcher/Config.in"
source "$BR2_EXTERNAL_ADDON_PACKAGES_PATH/package/wpeframework-opensource/wpeframework-doofah/Config.in"
source "$BR2_EXTERNAL_ADDON_PACKAGES_PATH/package/wpeframework-opensource/wpeframework-screensaver/Config.in"
endmenu

source "$BR2_EXTERNAL_ADDON_PACKAGES_PATH/package/wpeframework-opensource/wpeframework-ui/Config.in"

source "$BR2_EXTERNAL_ADDON_PACKAGES_PATH/package/wpeframework-opensource/wpeframework-interfaces/Config.in"
source "$BR2_EXTERNAL_ADDON_PACKAGES_PATH/package/wpeframework-opensource/wpeframework-clientlibraries/Config.in"
source "$BR2_EXTERNAL_ADDON_PACKAGES_PATH/package/wpeframework-opensource/wpeframework-libraries/Config.in"
source "$BR2_EXTERNAL_ADDON_PACKAGES_PATH/package/wpeframework-opensource/wpeframework-rdkservices/Config.in"
```

## addon/package/wpeframework-restricted/Config.in
```kconfig
menu "WPEFramework Plugins"
source "$BR2_EXTERNAL_ADDON_PACKAGES_PATH/package/wpeframework-restricted/wpetvplatform-bcm/Config.in"
source "$BR2_EXTERNAL_ADDON_PACKAGES_PATH/package/wpeframework-restricted/wpeframework-amazon/Config.in"
source "$BR2_EXTERNAL_ADDON_PACKAGES_PATH/package/wpeframework-restricted/wpeframework-avnclient/Config.in"
source "$BR2_EXTERNAL_ADDON_PACKAGES_PATH/package/wpeframework-restricted/wpeframework-netflix/Config.in"
source "$BR2_EXTERNAL_ADDON_PACKAGES_PATH/package/wpeframework-restricted/wpeframework-playgiga/Config.in"
source "$BR2_EXTERNAL_ADDON_PACKAGES_PATH/package/wpeframework-restricted/wpeframework-provisioning/Config.in"
source "$BR2_EXTERNAL_ADDON_PACKAGES_PATH/package/wpeframework-restricted/wpeframework-spotify/Config.in"
source "$BR2_EXTERNAL_ADDON_PACKAGES_PATH/package/wpeframework-restricted/wpetvplatform-bcm/Config.in"
endmenu
```

## addon/package/wpeframework-restricted/wpeframework-playgiga/Config.in
```kconfig
config BR2_PACKAGE_WPEFRAMEWORK_PLAYGIGA
	bool "PlayGiga"
	depends on BR2_PACKAGE_PLAYGIGA
	help
	   WPE Platform PlayGiga plugin

comment "PlayGiga needs playgiga."
    depends on ! BR2_PACKAGE_PLAYGIGA
```
