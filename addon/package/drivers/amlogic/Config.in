## addon/package/drivers/amlogic/Config.in
```kconfig
menuconfig BR2_PACKAGE_AMLOGIC_SDK
	bool "amlogic bsp"
	help
	  AMLogic Base Support package

if BR2_PACKAGE_AMLOGIC_SDK

source "$BR2_EXTERNAL_ADDON_PACKAGES_PATH/package/drivers/amlogic/aml-mali-driver/Config.in"
source "$BR2_EXTERNAL_ADDON_PACKAGES_PATH/package/drivers/amlogic/aml-media-driver/Config.in"
source "$BR2_EXTERNAL_ADDON_PACKAGES_PATH/package/drivers/amlogic/aml-optee-driver/Config.in"

source "$BR2_EXTERNAL_ADDON_PACKAGES_PATH/package/drivers/amlogic/aml-media-hal/Config.in"
source "$BR2_EXTERNAL_ADDON_PACKAGES_PATH/package/drivers/amlogic/aml-media-drm/Config.in"
source "$BR2_EXTERNAL_ADDON_PACKAGES_PATH/package/drivers/amlogic/aml-mali-meson/Config.in"
source "$BR2_EXTERNAL_ADDON_PACKAGES_PATH/package/drivers/amlogic/aml-common-lib/Config.in"
source "$BR2_EXTERNAL_ADDON_PACKAGES_PATH/package/drivers/amlogic/aml-audio-utils/Config.in"
source "$BR2_EXTERNAL_ADDON_PACKAGES_PATH/package/drivers/amlogic/aml-media-utils/Config.in"

source "$BR2_EXTERNAL_ADDON_PACKAGES_PATH/package/drivers/amlogic/aml-audio-service/Config.in"
source "$BR2_EXTERNAL_ADDON_PACKAGES_PATH/package/drivers/amlogic/aml-avsync/Config.in"

endif
```

## addon/package/drivers/amlogic/aml-amaudioutils/Config.in
```kconfig
config BR2_PACKAGE_AML_AMAUDIOUTILS
    bool "aml-amaudioutils"
    select BR2_PACKAGE_BOOST
    select BR2_PACKAGE_AML_COMMONLIB
```

## addon/package/drivers/amlogic/aml-audio-utils/Config.in
```kconfig
config BR2_PACKAGE_AML_AUDIO_UTILS
    bool "aml-audio-utils"
    select BR2_PACKAGE_BOOST
    select BR2_PACKAGE_AML_COMMON_LIB
```

## addon/package/drivers/amlogic/aml-mali-driver/Config.in
```kconfig
config BR2_PACKAGE_AML_MALI_DRIVER
	bool "aml-mali-driver"
	depends on BR2_arm
	depends on BR2_LINUX_KERNEL
	help
	  MALI driver platform

comment "mali needs BR2_arm"
	depends on !BR2_arm
```

## addon/package/drivers/amlogic/aml-mali-meson/Config.in
```kconfig
config BR2_PACKAGE_AML_MALI_MESON
	bool "aml-mali-meson"
	depends on BR2_arm
	select BR2_PACKAGE_HAS_LIBEGL
	select BR2_PACKAGE_HAS_LIBGLES
	select BR2_PACKAGE_HAS_LIBGBM
	select BR2_PACKAGE_LIBDRM
	help
	  MALI driver platform

comment "mali needs BR2_arm"
	depends on !BR2_arm

if BR2_PACKAGE_AML_MALI_MESON

config BR2_PACKAGE_PROVIDES_LIBEGL
    string
	default "aml-mali-meson"

config BR2_PACKAGE_PROVIDES_LIBGBM
    string
	default "aml-mali-meson"

config BR2_PACKAGE_PROVIDES_LIBGLES
    string
	default "aml-mali-meson"

config BR2_PACKAGE_SDK_INSTALL
    string
	default "aml-mali-meson"

endif
```

## addon/package/drivers/amlogic/aml-media-drm/Config.in
```kconfig
config BR2_PACKAGE_AML_MEDIA_DRM
    bool "aml-media-drm"
    select BR2_PACKAGE_AML_MEDIA_HAL
    select BR2_PACKAGE_OPENSSL
```

## addon/package/drivers/amlogic/aml-media-utils/Config.in
```kconfig
menuconfig BR2_PACKAGE_AML_MEDIA_UTILS
        bool "media utilities"
        help
          AMLogic media utilities

if BR2_PACKAGE_AML_MEDIA_UTILS

config BR2_PACKAGE_DOLBY_MS12
    bool "dolby-ms12"

endif
```

## addon/package/drivers/amlogic/aml-mediadrm/Config.in
```kconfig
config BR2_PACKAGE_AML_SECMEM
    bool "aml-secmem"
    select BR2_PACKAGE_AML_MEDIAHAL_BSP
    select BR2_PACKAGE_OPENSSL
```

## addon/package/gst1-amlogic/Config.in
```kconfig
menuconfig BR2_PACKAGE_GST1_AMLOGIC
	bool "gst1-amlogic"
	depends on BR2_PACKAGE_PLATCO_TV_BSP
	help
	  Amlogic NEXUS GStreamer 1.x plugins

if BR2_PACKAGE_GST1_AMLOGIC

source "$BR2_EXTERNAL_ML_CSS_PATH/package/gst1-amlogic/gst1-amlogic-asink/Config.in"
source "$BR2_EXTERNAL_ML_CSS_PATH/package/gst1-amlogic/gst1-amlogic-pcr-sink/Config.in"

endif
```

## addon/package/gst1-amlogic/gst1-amlogic-asink/Config.in
```kconfig
config BR2_PACKAGE_GST1_AMLOGIC_ASINK
    bool "gst1-amlogic-asink"
    depends on BR2_PACKAGE_GSTREAMER1
    select BR2_PACKAGE_AML_AVSYNC
    help
        Amlogic GStreamer1 plugins 1.0 to send audio es to aml dsp and video es to aml hw decoder. decode and render will be complete at kernel level.
```

## addon/package/gst1-amlogic/gst1-amlogic-drm-plugins/Config.in
```kconfig
config BR2_PACKAGE_GST1_AMLOGIC_DRM_PLUGINS
    bool "gst1-amlogic-drm-plugins"
    depends on BR2_PACKAGE_GSTREAMER1
    help
        Amlogic GStreamer1 plugins 1.0 to send audio es to aml dsp and video es to aml hw decoder. decode and render will be complete at kernel level.
```

## addon/package/gst1-amlogic/gst1-amlogic-pcr-sink/Config.in
```kconfig
config BR2_PACKAGE_GST1_AMLOGIC_PCR_SINK
    bool "gst1-amlogic-prc-sink"
    depends on BR2_PACKAGE_GSTREAMER1
    help
        Amlogic GStreamer1 plugins 1.0 to send audio es to aml dsp and video es to aml hw decoder. decode and render will be complete at kernel level.
```

## addon/package/gst1-amlogic/gst1-amlogic-plugins/Config.in
```kconfig
config BR2_PACKAGE_GST1_AMLOGIC_PLUGINS
    bool "gst1-amlogic-plugins"
    depends on BR2_PACKAGE_GSTREAMER1
    depends on BR2_PACKAGE_LIBPLAYER
    select BR2_PACKAGE_SPEEXDSP
    help
        Amlogic GStreamer1 plugins 1.0 to send audio es to aml dsp and video es to aml hw decoder. decode and render will be complete at kernel level.

config BR2_PACKAGE_GST1_AMLOGIC_PLUGINS_AUDIO_HAL_SINK
    bool "gst1-aml-audio-hal-sink"
    depends on BR2_PACKAGE_GST1_AMLOGIC_PLUGINS
    depends on BR2_PACKAGE_HAL_AUDIO_SERVICE
```

## addon/package/gyp/Config.in
```kconfig
config BR2_PACKAGE_GYP
        bool "gyp"
	select BR2_PACKAGE_PYTHON3
        help
           GYP is a Meta-Build system: a build system that generates other build systems
```

## addon/package/libprovision/Config.in
```kconfig
config BR2_PACKAGE_LIBPROVISION
	bool "libprovision"
	select BR2_PACKAGE_OPENSSL
 	depends on BR2_PACKAGE_CPPSDK_GENERICS || BR2_PACKAGE_WPEFRAMEWORK
	depends on BR2_arm || BR2_aarch64 || BR2_mipsel || BR2_i386
	depends on BR2_INSTALL_LIBSTDCPP
	depends on BR2_TOOLCHAIN_HAS_THREADS
	help
	  http://www.metrological.com

comment "libprovision needs a supported cpu arch, threads, stdcpp, thunder" 
    depends on !(BR2_PACKAGE_CPPSDK_GENERICS || BR2_PACKAGE_WPEFRAMEWORK) || !(BR2_arm || BR2_aarch64 || BR2_mipsel || BR2_i386) || !BR2_INSTALL_LIBSTDCPP || !BR2_TOOLCHAIN_HAS_THREADS
```

## addon/package/llama/Config.in
```kconfig
config BR2_PACKAGE_LLAMA
	bool "llama"
        select BR2_PACKAGE_GGML
        depends on BR2_GCC_ENABLE_OPENMP

comment "llama needs a toolchain with OpenMP support"
        depends on !BR2_GCC_ENABLE_OPENMP
```

## addon/package/playready4/Config.in
```kconfig
config BR2_PACKAGE_PLAYREADY4
        select BR2_PACKAGE_HAS_PLAYREADY
        select BR2_PACKAGE_LIBCURL
        select BR2_PACKAGE_WPEFRAMEWORK_PROVISIONING if BR2_PACKAGE_WPEFRAMEWORK
        select BR2_PACKAGE_WPEFRAMEWORK_PROVISIONING_FILES if BR2_PACKAGE_WPEFRAMEWORK
        select BR2_PACKAGE_BRIDGE_PROVISIONING if BR2_PACKAGE_BRIDGE
        select BR2_PACKAGE_BRIDGE_PROVISIONING_FILES if BR2_PACKAGE_BRIDGE
        bool "Playready v4.0"
        help
          A playready v4 implementation port from Microsoft.

config BR2_PACKAGE_HAS_PLAYREADY
        bool

config BR2_PACKAGE_PROVIDES_PLAYREADY
        depends on BR2_PACKAGE_HAS_PLAYREADY
        string

if BR2_PACKAGE_PLAYREADY
config BR2_PACKAGE_PROVIDES_PLAYREADY
        default "playready4"
endif
```

## addon/package/sdk/Config.in
```kconfig
config BR2_PACKAGE_HAS_SDK
	bool

config BR2_PACKAGE_SDK_INSTALL
	depends on BR2_PACKAGE_HAS_SDK
	string

menu  "SDK's"
comment "External SDK's"
source "$BR2_EXTERNAL_ADDON_PACKAGES_PATH/package/sdk/amlogic/Config.in"
source "$BR2_EXTERNAL_ADDON_PACKAGES_PATH/package/sdk/explora-sdk/Config.in"
source "$BR2_EXTERNAL_ADDON_PACKAGES_PATH/package/sdk/platco-tv-sdk/Config.in"
source "$BR2_EXTERNAL_ADDON_PACKAGES_PATH/package/sdk/xione-sdk/Config.in"
endmenu
```

## addon/package/sdk/amlogic/Config.in
```kconfig
menuconfig BR2_PACKAGE_AMLOGIC_SDK
	bool "amlogic-sdk"
	help
	  AMLogic Base Support packager

if BR2_PACKAGE_AMLOGIC_SDK

source "$BR2_EXTERNAL_ADDON_PACKAGES_PATH/package/sdk/amlogic/aml-mali/Config.in"
source "$BR2_EXTERNAL_ADDON_PACKAGES_PATH/package/sdk/amlogic/aml-amaudioutils/Config.in"
source "$BR2_EXTERNAL_ADDON_PACKAGES_PATH/package/sdk/amlogic/aml-audio-service/Config.in"
source "$BR2_EXTERNAL_ADDON_PACKAGES_PATH/package/sdk/amlogic/aml-avsync/Config.in"
source "$BR2_EXTERNAL_ADDON_PACKAGES_PATH/package/sdk/amlogic/aml-commonlib/Config.in"
source "$BR2_EXTERNAL_ADDON_PACKAGES_PATH/package/sdk/amlogic/aml-mediahal-sdk/Config.in"
source "$BR2_EXTERNAL_ADDON_PACKAGES_PATH/package/sdk/amlogic/aml-secmem/Config.in"
source "$BR2_EXTERNAL_ADDON_PACKAGES_PATH/package/sdk/amlogic/dolby-ms12/Config.in"

endif
```
