## addon/configs/raspberrypi5_bridge_defconfig
```kconfig
BR2_aarch64=y
BR2_cortex_a76=y
BR2_PACKAGE_HOST_LINUX_HEADERS_CUSTOM_6_6=y
BR2_TOOLCHAIN_BUILDROOT_CXX=y
BR2_GLOBAL_PATCH_DIR="board/raspberrypi/patches"
BR2_DOWNLOAD_FORCE_CHECK_HASHES=y
BR2_SYSTEM_DHCP="eth0"
BR2_ROOTFS_POST_BUILD_SCRIPT="board/raspberrypi5/post-build.sh"
BR2_ROOTFS_POST_IMAGE_SCRIPT="board/raspberrypi5/post-image.sh"
BR2_LINUX_KERNEL=y
BR2_LINUX_KERNEL_CUSTOM_TARBALL=y
BR2_LINUX_KERNEL_CUSTOM_TARBALL_LOCATION="$(call github,raspberrypi,linux,576cc10e1ed50a9eacffc7a05c796051d7343ea4)/linux-576cc10e1ed50a9eacffc7a05c796051d7343ea4.tar.gz"
BR2_LINUX_KERNEL_DEFCONFIG="bcm2712"
BR2_LINUX_KERNEL_CONFIG_FRAGMENT_FILES="board/raspberrypi/linux-4k-page-size.fragment"
BR2_LINUX_KERNEL_DTS_SUPPORT=y
BR2_LINUX_KERNEL_INTREE_DTS_NAME="broadcom/bcm2712-rpi-5-b broadcom/bcm2712d0-rpi-5-b"
BR2_LINUX_KERNEL_NEEDS_HOST_OPENSSL=y
BR2_PACKAGE_BUSYBOX_SHOW_OTHERS=y
BR2_PACKAGE_XZ=y
BR2_PACKAGE_MESA3D=y
BR2_PACKAGE_MESA3D_GALLIUM_DRIVER_V3D=y
BR2_PACKAGE_MESA3D_OPENGL_ES=y
BR2_PACKAGE_RPI_FIRMWARE=y
BR2_PACKAGE_RPI_FIRMWARE_CONFIG_FILE="board/raspberrypi5/config_5.txt"
BR2_PACKAGE_RPI_FIRMWARE_CMDLINE_FILE="board/raspberrypi5/cmdline_5.txt"
# BR2_PACKAGE_RPI_FIRMWARE_INSTALL_DTB_OVERLAYS is not set
BR2_PACKAGE_DROPBEAR=y
BR2_PACKAGE_KMOD=y
BR2_PACKAGE_KMOD_TOOLS=y
BR2_TARGET_ROOTFS_EXT2=y
BR2_TARGET_ROOTFS_EXT2_4=y
BR2_TARGET_ROOTFS_EXT2_SIZE="120M"
# BR2_TARGET_ROOTFS_TAR is not set
BR2_PACKAGE_HOST_DOSFSTOOLS=y
BR2_PACKAGE_HOST_GENIMAGE=y
BR2_PACKAGE_HOST_KMOD_XZ=y
BR2_PACKAGE_HOST_MTOOLS=y
BR2_PACKAGE_KMS_CUBE=y
BR2_PACKAGE_BRIDGE=y
BR2_PACKAGE_BRIDGE_MESSAGING=y
BR2_PACKAGE_BRIDGE_COMPOSITORCLIENT=y
BR2_PACKAGE_BRIDGE_OPENCDM=y
BR2_PACKAGE_BRIDGE_DISPLAYINFO=y
BR2_PACKAGE_BRIDGE_PLAYERINFO=y
BR2_PACKAGE_PLUGIN_BLUETOOTHREMOTECONTROL=y
BR2_PACKAGE_PLUGIN_BLUETOOTHAUDIOSINK=y
BR2_PACKAGE_PLUGIN_BRIDGELINK=y
BR2_PACKAGE_PLUGIN_COMMANDER=y
BR2_PACKAGE_PLUGIN_COMPOSITOR=y
BR2_PACKAGE_PLUGIN_COMPOSITOR_AUTOSTART=y
BR2_PACKAGE_PLUGIN_COMPOSITOR_OUTOFPROCESS=y
BR2_PACKAGE_PLUGIN_DIALSERVER=y
BR2_PACKAGE_PLUGIN_DICTIONARY=y
BR2_PACKAGE_PLUGIN_DEVICEINFO=y
BR2_PACKAGE_PLUGIN_DHCPSERVER=y
BR2_PACKAGE_PLUGIN_DISPLAYINFO=y
BR2_PACKAGE_PLUGIN_LAUNCHER=y
BR2_PACKAGE_PLUGIN_LOCATIONSYNC=y
BR2_PACKAGE_PLUGIN_MONITOR=y
BR2_PACKAGE_PLUGIN_NETWORKCONTROL=y
BR2_PACKAGE_PLUGIN_OPENCDMSERVER=y
BR2_PACKAGE_CDMI_CLEARKEY=y
BR2_PACKAGE_PLUGIN_TIMESYNC=y
BR2_PACKAGE_PLUGIN_PLAYERINFO=y
BR2_PACKAGE_PLUGIN_REMOTECONTROL=y
BR2_PACKAGE_PLUGIN_SCREENSAVER=y
BR2_PACKAGE_PLUGIN_MESSAGECONTROL=y
BR2_PACKAGE_PLUGIN_WEBPROXY=y
BR2_PACKAGE_PLUGIN_WEBSERVER=y
BR2_PACKAGE_PLUGIN_WEBSHELL=y
BR2_PACKAGE_PLUGIN_WIFI=y
BR2_PACKAGE_PLUGIN_BUTLER=y
BR2_PACKAGE_PLUGIN_I2CCONTROL=y
BR2_PACKAGE_PLUGIN_IOCONTROL=y
BR2_PACKAGE_PLUGIN_ONEWIRECONTROL=y
BR2_PACKAGE_PLUGIN_RULEENGINE=y
BR2_PACKAGE_PLUGIN_SPICONTROL=y
BR2_PACKAGE_PLUGIN_VIRTUALCONTROL=y
BR2_PACKAGE_PLUGIN_ZIGBEECONTROL=y
BR2_PACKAGE_PLUGIN_ZWAVECONTROL=y
BR2_PACKAGE_PLUGIN_SWITCHBOARD=y
BR2_PACKAGE_BRIDGE_UI=y
```

## addon/configs/s905x5_defconfig
```kconfig
BR2_arm=y
BR2_cortex_a53=y
BR2_ARM_FPU_NEON_FP_ARMV8=y
BR2_PACKAGE_HOST_LINUX_HEADERS_CUSTOM_5_15=y
BR2_GCC_VERSION_12_X=y
BR2_TOOLCHAIN_BUILDROOT_CXX=y
BR2_PACKAGE_HOST_GDB=y
BR2_CCACHE=y
BR2_GLOBAL_PATCH_DIR="$(BR2_EXTERNAL_ADDON_PACKAGES_PATH)/patches"
# BR2_PIC_PIE is not set
BR2_RELRO_NONE=y
BR2_ROOTFS_DEVICE_CREATION_DYNAMIC_MDEV=y
BR2_TARGET_GENERIC_ROOT_PASSWD="root"
BR2_SYSTEM_DHCP="eth0"
BR2_ROOTFS_POST_IMAGE_SCRIPT="$(BR2_EXTERNAL_ADDON_PACKAGES_PATH)/board/sky/build_image.sh"
BR2_ROOTFS_POST_SCRIPT_ARGS="$(BR2_EXTERNAL_ADDON_PACKAGES_PATH)/board/sky/image"
BR2_LINUX_KERNEL=y
BR2_LINUX_KERNEL_CUSTOM_GIT=y
BR2_LINUX_KERNEL_CUSTOM_REPO_URL="git@github.com:NextGenInvestments/amlogic-kernel.git"
BR2_LINUX_KERNEL_CUSTOM_REPO_VERSION="main"
BR2_LINUX_KERNEL_DEFCONFIG="optimize_for_ott"
BR2_LINUX_KERNEL_UIMAGE=y
BR2_LINUX_KERNEL_DTS_SUPPORT=y
BR2_LINUX_KERNEL_INTREE_DTS_NAME="amlogic/s7d_s905x5m_bm201_linux"
BR2_LINUX_KERNEL_NEEDS_HOST_OPENSSL=y
BR2_PACKAGE_BUSYBOX_CONFIG="$(BR2_EXTERNAL_ADDON_PACKAGES_PATH)/board/sky/busybox.config"
BR2_PACKAGE_BITSTREAM_VERA=y
BR2_PACKAGE_CANTARELL=y
BR2_PACKAGE_FONT_AWESOME=y
BR2_PACKAGE_LIBERATION=y
BR2_PACKAGE_XKEYBOARD_CONFIG=y
BR2_PACKAGE_LUAJIT=y
BR2_PACKAGE_FDK_AAC=y
BR2_PACKAGE_SBC=y
BR2_PACKAGE_TREMOR=y
BR2_PACKAGE_FREETYPE=y
BR2_PACKAGE_GRAPHITE2=y
BR2_PACKAGE_HARFBUZZ=y
BR2_PACKAGE_LCMS2=y
BR2_PACKAGE_LIBDRM_NOUVEAU=y
BR2_PACKAGE_LIBDRM_OMAP=y
BR2_PACKAGE_LIBDRM_FREEDRENO=y
BR2_PACKAGE_LIBDRM_VC4=y
BR2_PACKAGE_LIBDRM_INSTALL_TESTS=y
BR2_PACKAGE_LIBMNG=y
BR2_PACKAGE_LIBPNG=y
BR2_PACKAGE_OPENJPEG=y
BR2_PACKAGE_WAYLAND=y
BR2_PACKAGE_WAYLAND_PROTOCOLS=y
BR2_PACKAGE_WEBP=y
BR2_PACKAGE_LIBUSB=y
BR2_PACKAGE_LIBUSB_COMPAT=y
BR2_PACKAGE_LIBXKBCOMMON=y
BR2_PACKAGE_LIBOPENH264=y
BR2_PACKAGE_LIBCURL=y
BR2_PACKAGE_NGHTTP2=y
BR2_PACKAGE_ICU=y
BR2_PACKAGE_DROPBEAR=y
BR2_TARGET_ROOTFS_CPIO=y
BR2_TARGET_ROOTFS_SQUASHFS=y
BR2_PACKAGE_HOST_CRYPTSETUP=y
BR2_PACKAGE_KMS_CUBE=y
BR2_PACKAGE_AMLOGIC_SDK=y
BR2_PACKAGE_AML_MALI_DRIVER=y
BR2_PACKAGE_AML_MEDIA_DRIVER=y
BR2_PACKAGE_AML_OPTEE_DRIVER=y
BR2_PACKAGE_AML_HDCP=y
BR2_PACKAGE_AML_MEDIA_DRM=y
BR2_PACKAGE_AML_MALI_MESON=y
BR2_PACKAGE_AML_AUDIO_UTILS=y
BR2_PACKAGE_AML_AUDIO_SYNC=y
BR2_PACKAGE_AML_AUDIO_SERVICE=y
BR2_PACKAGE_AML_MEDIA_UTILS=y
```

## addon/configs/skyglass_tv_defconfig
```kconfig
BR2_arm=y
BR2_cortex_a53=y
BR2_ARM_FPU_NEON_FP_ARMV8=y
BR2_KERNEL_HEADERS_4_9=y
BR2_TOOLCHAIN_BUILDROOT_CXX=y
BR2_PACKAGE_HOST_GDB=y
BR2_CCACHE=y
BR2_GLOBAL_PATCH_DIR="$(BR2_EXTERNAL_ADDON_PACKAGES_PATH)/patches"
# BR2_PIC_PIE is not set
BR2_SSP_NONE=y
BR2_RELRO_NONE=y
BR2_FORTIFY_SOURCE_NONE=y
BR2_ROOTFS_DEVICE_CREATION_DYNAMIC_MDEV=y
BR2_TARGET_GENERIC_ROOT_PASSWD="root"
BR2_SYSTEM_DHCP="eth0"
BR2_ROOTFS_POST_IMAGE_SCRIPT="$(BR2_EXTERNAL_ADDON_PACKAGES_PATH)/board/sky/build_image.sh"
BR2_ROOTFS_POST_SCRIPT_ARGS="$(BR2_EXTERNAL_ADDON_PACKAGES_PATH)/board/sky/image"
BR2_LINUX_KERNEL=y
BR2_LINUX_KERNEL_CUSTOM_GIT=y
BR2_LINUX_KERNEL_CUSTOM_REPO_URL="git@github.com:Metrological/amlogic-linux-meson.git"
BR2_LINUX_KERNEL_CUSTOM_REPO_VERSION="stable2_patched"
BR2_LINUX_KERNEL_USE_CUSTOM_CONFIG=y
BR2_LINUX_KERNEL_CUSTOM_CONFIG_FILE="$(BR2_EXTERNAL_ADDON_PACKAGES_PATH)/board/sky/linux-4.9.config"
BR2_LINUX_KERNEL_UIMAGE=y
BR2_LINUX_KERNEL_DTS_SUPPORT=y
BR2_LINUX_KERNEL_INTREE_DTS_NAME="amlogic/tm2_revb_t962x3_llama_drm_cad2"
BR2_LINUX_KERNEL_NEEDS_HOST_OPENSSL=y
BR2_PACKAGE_BUSYBOX_CONFIG="$(BR2_EXTERNAL_ADDON_PACKAGES_PATH)/board/sky/busybox.config"
BR2_PACKAGE_BITSTREAM_VERA=y
BR2_PACKAGE_CANTARELL=y
BR2_PACKAGE_FONT_AWESOME=y
BR2_PACKAGE_LIBERATION=y
BR2_PACKAGE_EFL=y
BR2_PACKAGE_LUAJIT=y
BR2_PACKAGE_NODEJS=y
BR2_PACKAGE_SBC=y
BR2_PACKAGE_LIBDRM_NOUVEAU=y
BR2_PACKAGE_LIBDRM_OMAP=y
BR2_PACKAGE_LIBDRM_FREEDRENO=y
BR2_PACKAGE_LIBDRM_VC4=y
BR2_PACKAGE_LIBDRM_INSTALL_TESTS=y
BR2_PACKAGE_LIBUSB=y
BR2_PACKAGE_LIBUSB_COMPAT=y
BR2_PACKAGE_DROPBEAR=y
BR2_TARGET_ROOTFS_CPIO=y
BR2_TARGET_ROOTFS_SQUASHFS=y
BR2_PACKAGE_HOST_CRYPTSETUP=y
BR2_PACKAGE_KMS_CUBE=y
BR2_PACKAGE_WESTEROS=y
BR2_PACKAGE_WPEWEBKIT_ML=y
BR2_PACKAGE_AMLOGIC_SDK=y
BR2_PACKAGE_AML_MALI_DRIVER=y
BR2_PACKAGE_AML_MEDIA_DRIVER=y
BR2_PACKAGE_AML_OPTEE_DRIVER=y
BR2_PACKAGE_AML_HDCP=y
BR2_PACKAGE_AML_MEDIA_DRM=y
BR2_PACKAGE_AML_MALI_MESON=y
BR2_PACKAGE_AML_AUDIO_UTILS=y
BR2_PACKAGE_AML_AUDIO_SYNC=y
BR2_PACKAGE_AML_AUDIO_SERVICE=y
BR2_PACKAGE_AML_MEDIA_UTILS=y
BR2_PACKAGE_NETFLIX52=y
BR2_PACKAGE_NETFLIX52_DRM_PLAYREADY=y
BR2_PACKAGE_WPEFRAMEWORK_MESSAGING=y
BR2_PACKAGE_WPEFRAMEWORK_DISABLE_LEGACY_CONFIG_GENERATOR=y
BR2_PACKAGE_WPEFRAMEWORK_CLIENTLIBRARY_CRYPTOGRAPHY=y
BR2_PACKAGE_WPEFRAMEWORK_SECURITYAGENT_ACCESSOR=y
BR2_PACKAGE_WPEFRAMEWORK_BLUETOOTHREMOTECONTROL=y
BR2_PACKAGE_WPEFRAMEWORK_CDMI=y
BR2_PACKAGE_WPEFRAMEWORK_CDMI_CLEARKEY=y
BR2_PACKAGE_WPEFRAMEWORK_CDMI_PLAYREADY_MODULE=y
BR2_PACKAGE_WPEFRAMEWORK_CDMI_PLAYREADY_CERTIFICATE_LABEL="PLAYREADY"
BR2_PACKAGE_WPEFRAMEWORK_CDMI_WIDEVINE_MODULE=y
BR2_PACKAGE_WIDEVINE_VERSION_16=y
BR2_PACKAGE_WPEFRAMEWORK_COBALT=y
BR2_PACKAGE_WPEFRAMEWORK_COMPOSITOR=y
BR2_PACKAGE_WPEFRAMEWORK_DEVICEIDENTIFICATION=y
BR2_PACKAGE_WPEFRAMEWORK_DHCPSERVER=y
BR2_PACKAGE_WPEFRAMEWORK_DIALSERVER=y
BR2_PACKAGE_WPEFRAMEWORK_DICTIONARY=y
BR2_PACKAGE_WPEFRAMEWORK_FILETRANSFER=y
BR2_PACKAGE_WPEFRAMEWORK_IOCONNECTOR=y
BR2_PACKAGE_WPEFRAMEWORK_LOCATIONSYNC=y
BR2_PACKAGE_WPEFRAMEWORK_MESSENGER=y
BR2_PACKAGE_WPEFRAMEWORK_MONITOR=y
BR2_PACKAGE_WPEFRAMEWORK_PLAYERINFO=y
BR2_PACKAGE_WPEFRAMEWORK_REMOTECONTROL=y
BR2_PACKAGE_WPEFRAMEWORK_MESSAGECONTROL=y
BR2_PACKAGE_WPEFRAMEWORK_WEBKITBROWSER=y
BR2_PACKAGE_WPEFRAMEWORK_WEBSERVER=y
BR2_PACKAGE_WPEFRAMEWORK_WIFICONTROL=y
BR2_PACKAGE_WPEFRAMEWORK_NETFLIX=y
```

## addon/package/Config.in
```kconfig
source "$BR2_EXTERNAL_ADDON_PACKAGES_PATH/package/amazon-alexa-opensource/Config.in"
source "$BR2_EXTERNAL_ADDON_PACKAGES_PATH/package/cobalt/Config.in"
source "$BR2_EXTERNAL_ADDON_PACKAGES_PATH/package/gyp/Config.in"
source "$BR2_EXTERNAL_ADDON_PACKAGES_PATH/package/kms-cube/Config.in"
source "$BR2_EXTERNAL_ADDON_PACKAGES_PATH/package/libdash/Config.in"
source "$BR2_EXTERNAL_ADDON_PACKAGES_PATH/package/libdrm-examples/Config.in"
source "$BR2_EXTERNAL_ADDON_PACKAGES_PATH/package/libsoup3/Config.in"
source "$BR2_EXTERNAL_ADDON_PACKAGES_PATH/package/rdksplashscreen/Config.in"
source "$BR2_EXTERNAL_ADDON_PACKAGES_PATH/package/wpeframework-opensource/Config.in"
source "$BR2_EXTERNAL_ADDON_PACKAGES_PATH/package/westeros/Config.in"
source "$BR2_EXTERNAL_ADDON_PACKAGES_PATH/package/wpebackend/Config.in"
source "$BR2_EXTERNAL_ADDON_PACKAGES_PATH/package/wpebackend-rdk/Config.in"
source "$BR2_EXTERNAL_ADDON_PACKAGES_PATH/package/wpewebkit-ml/Config.in"
source "$BR2_EXTERNAL_ADDON_PACKAGES_PATH/package/drivers/Config.in"
source "$BR2_EXTERNAL_ADDON_PACKAGES_PATH/package/sdk/Config.in"
source "$BR2_EXTERNAL_ADDON_PACKAGES_PATH/package/aamp/Config.in"
source "$BR2_EXTERNAL_ADDON_PACKAGES_PATH/package/aampabr/Config.in"
source "$BR2_EXTERNAL_ADDON_PACKAGES_PATH/package/amazon-alexa-restricted/Config.in"
source "$BR2_EXTERNAL_ADDON_PACKAGES_PATH/package/amazon-backend/Config.in"
source "$BR2_EXTERNAL_ADDON_PACKAGES_PATH/package/amazon-ignition/Config.in"
source "$BR2_EXTERNAL_ADDON_PACKAGES_PATH/package/bcm-refsw/Config.in"
source "$BR2_EXTERNAL_ADDON_PACKAGES_PATH/package/gst1-aamp/Config.in"
source "$BR2_EXTERNAL_ADDON_PACKAGES_PATH/package/gst1-amlogic/Config.in"
source "$BR2_EXTERNAL_ADDON_PACKAGES_PATH/package/gst1-bcm/Config.in"
source "$BR2_EXTERNAL_ADDON_PACKAGES_PATH/package/libprovision/Config.in"
source "$BR2_EXTERNAL_ADDON_PACKAGES_PATH/package/mfr-library/Config.in"
source "$BR2_EXTERNAL_ADDON_PACKAGES_PATH/package/netflix52/Config.in"
source "$BR2_EXTERNAL_ADDON_PACKAGES_PATH/package/nexus/Config.in"
source "$BR2_EXTERNAL_ADDON_PACKAGES_PATH/package/playready4/Config.in"
source "$BR2_EXTERNAL_ADDON_PACKAGES_PATH/package/wpeframework-restricted/Config.in"
source "$BR2_EXTERNAL_ADDON_PACKAGES_PATH/package/widevine/Config.in"
```

## addon/package/amazon-alexa-restricted/Config.in
```kconfig
menu "amazon alexa"
source "$BR2_EXTERNAL_ADDON_PACKAGES_PATH/package/amazon-alexa-restricted/alexa-pryon-kwd/Config.in"
endmenu
```

## addon/package/bridge/Config.in
```kconfig
# Bridge Tools/Generators
source "$BR2_EXTERNAL_ADDON_PACKAGES_PATH/package/bridge/bridge-tools/Config.in"

# Bridge framework
source "$BR2_EXTERNAL_ADDON_PACKAGES_PATH/package/bridge/bridge/Config.in"
```

## addon/package/bridge/bridge-clients/Config.in
```kconfig
config BR2_PACKAGE_BRIDGE_CLIENTS
        bool 

config BR2_PACKAGE_BRIDGE_BUTLERCLIENT
        bool "ButlerClient"
        select BR2_PACKAGE_BRIDGE_CLIENTS
        help
          A client library that exposes a C++ interface (process agnostic) to interact with the 
          ButlerPlugin

config BR2_PACKAGE_BRIDGE_COMPOSITORCLIENT
        bool "CompositorClient"
	select BR2_PACKAGE_BRIDGE_CONTRACTS
        select BR2_PACKAGE_BRIDGE_CLIENTS
        help
          A graphical/input abstraction. This library is included in micro services that requires user
          interaction (Graphics/input). The implementation hides all the compositor specific details.
          allows for relaying keys to plugins

menuconfig BR2_PACKAGE_BRIDGE_CRYPTOGRAPHY
	select BR2_PACKAGE_BRIDGE_CONTRACTS
        select BR2_PACKAGE_BRIDGE_CLIENTS
        bool "Cryptography"
        default n
        help
          Abstraction on generic cryptography functionality.

if BR2_PACKAGE_BRIDGE_CRYPTOGRAPHY
choice BR2_PACKAGE_BRIDGE_CRYPTOGRAPHY_IMPLEMENTATION
        prompt "Implementation"
        default BR2_PACKAGE_BRIDGE_CRYPTOGRAPHY_IMPLEMENTATION_OPENSSL
        help
          Choose implementation

config BR2_PACKAGE_BRIDGE_CRYPTOGRAPHY_IMPLEMENTATION_THUNDER
        bool "Thunder"
        help
          Use Thunder as cryptography backend.

config BR2_PACKAGE_BRIDGE_CRYPTOGRAPHY_IMPLEMENTATION_OPENSSL
        bool "OpenSSL"
        depends on BR2_PACKAGE_OPENSSL
        help
          Use OpenSSL as cryptography backend.

config BR2_PACKAGE_BRIDGE_CRYPTOGRAPHY_IMPLEMENTATION_NEXUS
        bool "Nexus"
        depends on BR2_PACKAGE_HAS_NEXUS
        help
          Use Nexus as cryptography backend.
endchoice

endif

config BR2_PACKAGE_BRIDGE_DEVICEINFO
	select BR2_PACKAGE_BRIDGE_CONTRACTS
        select BR2_PACKAGE_BRIDGE_CLIENTS
        bool "DeviceInfo"
        default y if BR2_PACKAGE_PLUGIN_DEVICEINFO
        help
            A helpful C-interface to easily get information from the DeviceInfo plugin.

config BR2_PACKAGE_BRIDGE_DISPLAYINFO
	select BR2_PACKAGE_BRIDGE_CONTRACTS
        select BR2_PACKAGE_BRIDGE_CLIENTS
        bool "DisplayInfo"
        default n
        help
          A helpful C-interface to easily get information from the DisplayInfo plugin.

config BR2_PACKAGE_BRIDGE_GRAPHICS_BUFFER
        bool "GraphicsBuffer"
	select BR2_PACKAGE_BRIDGE_CONTRACTS
        select BR2_PACKAGE_BRIDGE_CLIENTS
        help
          Implementation of a Graphics buffer onto the hardware, implementing the IGraphicsBuffer interface.

config BR2_PACKAGE_BRIDGE_OPENCDM
        bool "OpenCDM"
	select BR2_PACKAGE_BRIDGE_CONTRACTS
        select BR2_PACKAGE_BRIDGE_CLIENTS
        select BR2_PACKAGE_GSTREAMER1
        help
          Creates a ocdm compatible library to be used as a plugin to the OpenCDMServer in the bridge.

config BR2_PACKAGE_BRIDGE_PLAYERINFO
	select BR2_PACKAGE_BRIDGE_CONTRACTS
        select BR2_PACKAGE_BRIDGE_CLIENTS
        select BR2_PACKAGE_GSTREAMER1
        bool "PlayerInfo"
        default n
        help
          A helpful C-interface to easily get information from the PlayerInfo plugin.

config BR2_PACKAGE_BRIDGE_PROVISIONPROXY
        bool "ProvisionProxy"
	select BR2_PACKAGE_BRIDGE_CONTRACTS
        select BR2_PACKAGE_LIBPROVISION
        select BR2_PACKAGE_BRIDGE_CLIENTS
        help
          Allows provisioning of modules from the cloud.

config BR2_PACKAGE_BRIDGE_VIRTUALINPUT
        bool "VirtualInput"
	select BR2_PACKAGE_BRIDGE_CONTRACTS
        select BR2_PACKAGE_BRIDGE_CLIENTS
        help
          If the dynamic uinput system can not be used for security reasons, this
          allows for relaying keys to plugins
```

## addon/package/bridge/bridge-controller/Config.in
```kconfig
config BR2_PACKAGE_BRIDGE_CONTROLLER
	bool "framework UI"
	default y

	help
	   The UI to control the bridge framework
```

## addon/package/bridge/bridge-ui/Config.in
```kconfig
config BR2_PACKAGE_BRIDGE_UI
	bool "UI"
	default n

	help
	   Bridge User Interface for domotica frontend
```
