## addon/package/bridge/bridge/Config.in
```kconfig
config BR2_PACKAGE_BRIDGE
	bool "bridge"
        depends on BR2_INSTALL_LIBSTDCPP
        depends on BR2_TOOLCHAIN_HAS_THREADS 
	help
	  Framework to build the functionality to realize a plugin structure for 
          rapid and easy development of REST-full API modules that realize simple
          interconnection between JavScript world and the Embedded platform.

comment "bridge depends on a toolchain w/ C++, threads support"
        depends on !BR2_INSTALL_LIBSTDCPP || !BR2_TOOLCHAIN_HAS_THREADS 

if BR2_PACKAGE_BRIDGE

menu "Bridge"

source "$BR2_EXTERNAL_ADDON_PACKAGES_PATH/package/bridge/bridge-contracts/Config.in"

source "$BR2_EXTERNAL_ADDON_PACKAGES_PATH/package/bridge/bridge-controller/Config.in"

config BR2_PACKAGE_BRIDGE_BLUETOOTH
       bool "bluetooth"
       select BR2_PACKAGE_BLUEZ5_UTILS_HEADERS
       help 
          Bluetooth abstraction layer on top of Bluez (Kernel module stuff).

config 	BR2_PACKAGE_BRIDGE_NETWORKING
	bool "networking"
	default n
	select BR2_PACKAGE_IPTABLES
	help 
          C Abstraction layer on top of linux (and partially windows) network functionality.

config 	BR2_PACKAGE_BRIDGE_DEVICES
	bool "devices"
	select BR2_PACKAGE_LIBUSB
	help 
          Devices contains several hardware abstractions for IC found out there.

config 	BR2_PACKAGE_BRIDGE_LOCALTRACER
	bool "localtracer"
	help 
          A simple helper library to display Messages in a local process..

config BR2_PACKAGE_BRIDGE_ZWAVE
	bool "zwave"
	help 
          Implementation of the ZWave protocol over a SerialAPI

config BR2_PACKAGE_BRIDGE_ZIGBEE
	bool "zigbee"
	help 
          Implementation of the ZigBee(RC,LL,HA) protocol over a SerialAPI
	
menu "Options"

config BR2_PACKAGE_BRIDGE_PORT
	string "port"
	default "80"

config BR2_PACKAGE_BRIDGE_BIND
	string "bind"
	default "0.0.0.0"

config BR2_PACKAGE_BRIDGE_INTERFACE
	string "interface"
	default ""

config BR2_PACKAGE_BRIDGE_IDLE_TIME
	string "idle-time"
	default "180"

config BR2_PACKAGE_BRIDGE_PERSISTENT_PATH
	string "persistent path"
	default "/root"

config BR2_PACKAGE_BRIDGE_VOLATILE_PATH
	string "volatile path"
	default "/tmp"

config BR2_PACKAGE_BRIDGE_DATA_PATH
	string "data path"
	default "/usr/share/bridge"

config BR2_PACKAGE_BRIDGE_SYSTEM_PATH
	string "system path"
	default "/usr/lib/bridge/plugins"

config BR2_PACKAGE_BRIDGE_PROXYSTUB_PATH
	string "proxystub path"
	default "/usr/lib/bridge/proxystubs"

config BR2_PACKAGE_BRIDGE_OOM_ADJUST
	string "oom-adjust"
	default ""

config BR2_PACKAGE_BRIDGE_SECURE_SOCKETS
	bool "secure sockets"
        default n
	help 
          Enables the posisbility to configure and run the framework over 
          https/wss (secure) sockets. Adds a dependency on OpenSSL or alike. 

config BR2_PACKAGE_BRIDGE_COMRPC_PLATFORM_DEFINITION
        bool "Select COMRPC platform"
	default n

if BR2_PACKAGE_BRIDGE_COMRPC_PLATFORM_DEFINITION

choice BR2_PACKAGE_BRIDGE_COMRPC_INSTANCE
        prompt "COMRPC instance length"
        default BR2_PACKAGE_BRIDGE_COMRPC_INSTANCE_32
        help
          For COMRPC crossplatform communication, the instanceid must be
          defined to fit the largest platform. This means select the 
          larget platform used in the exchange.

config BR2_PACKAGE_BRIDGE_COMRPC_INSTANCE_32
        bool "32bits platform"

config BR2_PACKAGE_BRIDGE_COMRPC_INSTANCE_64
        bool "64bits platform"


endchoice

endif

config BR2_PACKAGE_BRIDGE_MESSAGING
    bool "Use messaging i.s.o. tracing"
    default n
    help
      Use messaging which replaces the tracing + logging into one
      frmaework to relay the information to the parent process.

source "$BR2_EXTERNAL_ADDON_PACKAGES_PATH/package/bridge/bridge-devtools/Config.in"

endmenu

menu "Clients"

source "$BR2_EXTERNAL_ADDON_PACKAGES_PATH/package/bridge/bridge-clients/Config.in"

endmenu

menu "Plugins"
source "$BR2_EXTERNAL_ADDON_PACKAGES_PATH/package/bridge/plugin-common/Config.in"
source "$BR2_EXTERNAL_ADDON_PACKAGES_PATH/package/bridge/plugin-domotica/Config.in"
source "$BR2_EXTERNAL_ADDON_PACKAGES_PATH/package/bridge/plugin-netflix/Config.in"
source "$BR2_EXTERNAL_ADDON_PACKAGES_PATH/package/bridge/plugin-provisioning/Config.in"
source "$BR2_EXTERNAL_ADDON_PACKAGES_PATH/package/bridge/plugin-switchboard/Config.in"
source "$BR2_EXTERNAL_ADDON_PACKAGES_PATH/package/bridge/plugin-spotify/Config.in"
endmenu

menu "Domotica"
source "$BR2_EXTERNAL_ADDON_PACKAGES_PATH/package/bridge/bridge-ui/Config.in"
endmenu

endmenu

endif
```

## addon/package/bridge/plugin-cdmi/Config.in
```kconfig
source "$BR2_EXTERNAL_ADDON_PACKAGES_PATH/package/bridge/plugin-cdmi/cdmi-clearkey/Config.in"
source "$BR2_EXTERNAL_ADDON_PACKAGES_PATH/package/bridge/plugin-cdmi/cdmi-playready/Config.in"
source "$BR2_EXTERNAL_ADDON_PACKAGES_PATH/package/bridge/plugin-cdmi/cdmi-playready-nexus/Config.in"
source "$BR2_EXTERNAL_ADDON_PACKAGES_PATH/package/bridge/plugin-cdmi/cdmi-widevine/Config.in"
source "$BR2_EXTERNAL_ADDON_PACKAGES_PATH/package/bridge/plugin-cdmi/cdmi-nagra/Config.in"
```

## addon/package/bridge/plugin-domotica/Config.in
```kconfig
config BR2_PACKAGE_PLUGIN_DOMOTICA
	bool

config BR2_PACKAGE_PLUGIN_BARN
	bool "Barn"
	select BR2_PACKAGE_BRIDGE_DEVICES
        select BR2_PACKAGE_PLUGIN_DOMOTICA
	help
	   Hardcoded rules in a plugin for a dedictaed service.

config BR2_PACKAGE_PLUGIN_BUTLER
	bool "Butler"
        select BR2_PACKAGE_PLUGIN_DOMOTICA
	help
	   Butler plugin

config BR2_PACKAGE_PLUGIN_CLOUDRELAY
	bool "CloudRelay"
        select BR2_PACKAGE_PLUGIN_DOMOTICA
	help
	   CloudRelay plugin

config BR2_PACKAGE_PLUGIN_I2CCONTROL
	bool "I2CControl"
	select BR2_PACKAGE_BRIDGE_DEVICES
        select BR2_PACKAGE_PLUGIN_DOMOTICA
	help
	   I2CControl plugin

menuconfig BR2_PACKAGE_PLUGIN_IOCONTROL
	bool "IOControl"
	select BR2_PACKAGE_BRIDGE_DEVICES
        select BR2_PACKAGE_PLUGIN_DOMOTICA
	help
	   IOControl plugin

if BR2_PACKAGE_PLUGIN_IOCONTROL

config BR2_PACKAGE_PLUGIN_IOCONNECTOR_PINS
    string "Pin details"
    default ""
    help
      Set details of pins in the format "ID:Mode:State:PullUp".
      ID: Id of the PIN, Mode: Output/Input, State: activelow or not
      PullUp, up, down or nothing.
      Example "169:output:true;172:output:false"

endif

config BR2_PACKAGE_PLUGIN_NEXTGREENENERGY
	bool "PowerControlBoard"
        select BR2_PACKAGE_PLUGIN_DOMOTICA
	select BR2_PACKAGE_BRIDGE_DEVICES
	help
	   Controls the NextGreen Power Control Board over SPI.

config BR2_PACKAGE_PLUGIN_ONEWIRECONTROL
	bool "OneWireControl"
        select BR2_PACKAGE_PLUGIN_DOMOTICA
	select BR2_PACKAGE_BRIDGE_DEVICES
	help
	   1-Wire Control plugin

config BR2_PACKAGE_PLUGIN_RADIOCONTROL
	bool "RadioControl"
        select BR2_PACKAGE_PLUGIN_DOMOTICA
	help
	   RadioControl (NRF24L01) plugin

config BR2_PACKAGE_PLUGIN_RULEENGINE
	bool "RuleEngine"
        select BR2_PACKAGE_PLUGIN_DOMOTICA
	help
	   Rule Engine plugin

config BR2_PACKAGE_PLUGIN_RUSTBRIDGE
	bool "RustBridge"
        select BR2_PACKAGE_PLUGIN_DOMOTICA
	help
	   RUST Bridge plugin

config BR2_PACKAGE_PLUGIN_SCRIPTENGINE
	bool "ScriptEngine"
        select BR2_PACKAGE_PLUGIN_DOMOTICA
	select BR2_PACKAGE_NODEJS
	select BR2_PACKAGE_NODEJS_LIBRARY
	help
	   Script Engine plugin

config BR2_PACKAGE_PLUGIN_SPEECHTOTEXT
	bool "SpeechToText"
	depends on BR2_PACKAGE_WHISPER
	help
	  SpeechToText plugin

comment "SpeechToText plugin requires an AI Engine (like Whisper)"
        depends on !BR2_PACKAGE_WHISPER

config BR2_PACKAGE_PLUGIN_SPICONTROL
	bool "SPIControl"
	select BR2_PACKAGE_BRIDGE_DEVICES
        select BR2_PACKAGE_PLUGIN_DOMOTICA
	help
	   SPIControl plugin

config BR2_PACKAGE_PLUGIN_TEMPCONTROL
	bool "TempControl"
	select BR2_PACKAGE_BRIDGE_DEVICES
        select BR2_PACKAGE_PLUGIN_DOMOTICA
	help
	   TempControl plugin

config BR2_PACKAGE_PLUGIN_VIRTUALCONTROL
	bool "VirtualControl"
        select BR2_PACKAGE_PLUGIN_DOMOTICA
	help
	   VirtualControl plugin

config BR2_PACKAGE_PLUGIN_WATCHDOG
	bool "WatchDog"
        select BR2_PACKAGE_PLUGIN_DOMOTICA
	help
	   WatchDog plugin

menuconfig BR2_PACKAGE_PLUGIN_ZIGBEECONTROL
	bool "ZigBeeControl"
	select BR2_PACKAGE_BRIDGE_ZIGBEE
        select BR2_PACKAGE_PLUGIN_DOMOTICA
	help
	   ZIGBEE control plugin

if BR2_PACKAGE_PLUGIN_ZIGBEECONTROL

config BR2_PACKAGE_ZIGBEE_PORT
        string "port"
        default "/dev/ttyAMA0"

config BR2_PACKAGE_ZIGBEE_WATCHDOG_TIME
        string "watchdog"
        default "62"
        help
          Watchdog time in minutes. The hosts software will trigger the ZigBee
          device within this period (and configure the stick for this watchdog)

endif

menuconfig BR2_PACKAGE_PLUGIN_ZWAVECONTROL
	bool "ZWaveControl"
	select BR2_PACKAGE_BRIDGE_ZWAVE
        select BR2_PACKAGE_PLUGIN_DOMOTICA
	help
	   ZWAVE control plugin

if BR2_PACKAGE_PLUGIN_ZWAVECONTROL

config BR2_PACKAGE_ZWAVE_PORT
        string "port"
        default "/dev/ttyAMA0"

endif
```

## addon/package/drivers/Config.in
```kconfig
menu  "drivers"
comment "Platform drivers"
source "$BR2_EXTERNAL_ADDON_PACKAGES_PATH/package/drivers/amlogic/Config.in"
endmenu
```

## addon/package/drivers/amlogic-mali-driver/Config.in
```kconfig
config BR2_PACKAGE_AMLOGIC_MALI_DRIVER
	bool "amlogic mali driver"
	help
	  mali graphics driver for platco tv platform
```
