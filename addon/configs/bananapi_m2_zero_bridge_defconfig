## addon/configs/bananapi_m2_zero_bridge_defconfig
```kconfig
BR2_arm=y
BR2_cortex_a7=y
BR2_ARM_FPU_NEON_VFPV4=y
BR2_ARM_INSTRUCTIONS_THUMB2=y
BR2_PACKAGE_HOST_LINUX_HEADERS_CUSTOM_6_10=y
BR2_TOOLCHAIN_BUILDROOT_CXX=y
BR2_PACKAGE_HOST_GDB=y
BR2_GDB_VERSION_14=y
BR2_CURL="curl -q --ftp-pasv --retry 3"
BR2_WGET="wget -nd -t 3"
BR2_SVN="svn --non-interactive"
BR2_SCP="scp"
BR2_SFTP="sftp"
BR2_GNU_MIRROR="http://ftpmirror.gnu.org"
BR2_GLOBAL_PATCH_DIR="$(BR2_EXTERNAL)/patches"
BR2_FORTIFY_SOURCE_NONE=y
BR2_TARGET_GENERIC_HOSTNAME="IOTBananas"
BR2_TARGET_GENERIC_ISSUE="IOT"
BR2_TARGET_GENERIC_ROOT_PASSWD="root"
BR2_TARGET_GENERIC_GETTY_PORT="ttyS0"
BR2_ROOTFS_POST_BUILD_SCRIPT="$(BR2_EXTERNAL)/board/bananapi/bananapi-m2-zero/post-build.sh"
BR2_ROOTFS_POST_IMAGE_SCRIPT="$(TOPDIR)/support/scripts/genimage.sh"
BR2_ROOTFS_POST_SCRIPT_ARGS="-c $(BR2_EXTERNAL)/board/bananapi/bananapi-m2-zero/genimage.cfg"
BR2_LINUX_KERNEL=y
BR2_LINUX_KERNEL_CUSTOM_VERSION=y
BR2_LINUX_KERNEL_CUSTOM_VERSION_VALUE="6.10.14"
BR2_LINUX_KERNEL_USE_CUSTOM_CONFIG=y
BR2_LINUX_KERNEL_CUSTOM_CONFIG_FILE="$(BR2_EXTERNAL)/board/bananapi/bananapi-m2-zero/linux-6.10.config"
BR2_LINUX_KERNEL_DTS_SUPPORT=y
BR2_LINUX_KERNEL_INTREE_DTS_NAME="allwinner/sun8i-h2-plus-bananapi-m2-zero"
BR2_LINUX_KERNEL_DTB_OVERLAY_SUPPORT=y
BR2_PACKAGE_GST1_PLUGINS_BASE_LIB_OPENGL=y
BR2_PACKAGE_KMSCUBE=y
BR2_PACKAGE_MESA3D_GALLIUM_DRIVER_LIMA=y
BR2_PACKAGE_MESA3D_OPENGL_EGL=y
BR2_PACKAGE_MESA3D_OPENGL_ES=y
BR2_PACKAGE_CA_CERTIFICATES=y
BR2_PACKAGE_WAYLAND=y
BR2_PACKAGE_LIBSOUP3_SSL=y
BR2_PACKAGE_DROPBEAR=y
BR2_PACKAGE_DROPBEAR_DISABLE_REVERSEDNS=y
# BR2_PACKAGE_DROPBEAR_SMALL is not set
BR2_PACKAGE_GESFTPSERVER=y
# BR2_PACKAGE_IFUPDOWN_SCRIPTS is not set
BR2_PACKAGE_WIRELESS_TOOLS=y
BR2_PACKAGE_WIRELESS_TOOLS_LIB=y
BR2_PACKAGE_WPA_SUPPLICANT=y
BR2_PACKAGE_WPA_SUPPLICANT_AP_SUPPORT=y
BR2_PACKAGE_WPA_SUPPLICANT_AUTOSCAN=y
BR2_PACKAGE_WPA_SUPPLICANT_HOTSPOT=y
BR2_PACKAGE_WPA_SUPPLICANT_DEBUG_SYSLOG=y
BR2_PACKAGE_WPA_SUPPLICANT_WPS=y
BR2_PACKAGE_WPA_SUPPLICANT_WPA3=y
BR2_PACKAGE_WPA_SUPPLICANT_CTRL_IFACE=y
BR2_PACKAGE_UTIL_LINUX=y
BR2_PACKAGE_UTIL_LINUX_LIBUUID=y
BR2_PACKAGE_UTIL_LINUX_RFKILL=y
BR2_TARGET_ROOTFS_EXT2=y
BR2_TARGET_ROOTFS_EXT2_4=y
BR2_TARGET_ROOTFS_EXT2_SIZE="512M"
# BR2_TARGET_ROOTFS_TAR is not set
BR2_TARGET_UBOOT=y
BR2_TARGET_UBOOT_BOARDNAME="bananapi_m2_zero"
BR2_TARGET_UBOOT_CUSTOM_VERSION=y
BR2_TARGET_UBOOT_CUSTOM_VERSION_VALUE="2020.10"
BR2_TARGET_UBOOT_NEEDS_DTC=y
BR2_TARGET_UBOOT_NEEDS_PYLIBFDT=y
BR2_TARGET_UBOOT_FORMAT_CUSTOM=y
BR2_TARGET_UBOOT_FORMAT_CUSTOM_NAME="u-boot-sunxi-with-spl.bin"
BR2_PACKAGE_HOST_DOSFSTOOLS=y
BR2_PACKAGE_HOST_GENIMAGE=y
BR2_PACKAGE_HOST_MTOOLS=y
BR2_PACKAGE_HOST_SUNXI_TOOLS=y
BR2_PACKAGE_HOST_UBOOT_TOOLS=y
BR2_PACKAGE_HOST_UBOOT_TOOLS_BOOT_SCRIPT=y
BR2_PACKAGE_HOST_UBOOT_TOOLS_BOOT_SCRIPT_SOURCE="board/bananapi/bananapi-m2-zero/boot.cmd"
BR2_PACKAGE_KMS_CUBE=y
BR2_PACKAGE_WPEWEBKIT_ML=y
BR2_PACKAGE_WPEWEBKIT_ML_WEBRTC=y
BR2_PACKAGE_WPEWEBKIT_ML_WEBDRIVER=y
BR2_PACKAGE_PLAYREADY4=y
BR2_PACKAGE_BRIDGE_TOOLS=y
BR2_PACKAGE_BRIDGE=y
BR2_PACKAGE_BRIDGE_LOCALTRACER=y
BR2_PACKAGE_BRIDGE_COMRPC_PLATFORM_DEFINITION=y
BR2_PACKAGE_BRIDGE_COMRPC_INSTANCE_64=y
BR2_PACKAGE_BRIDGE_MESSAGING=y
BR2_PACKAGE_BRIDGE_RELEASE=y
BR2_PACKAGE_BRIDGE_COMPOSITORCLIENT=y
BR2_PACKAGE_BRIDGE_CRYPTOGRAPHY=y
BR2_PACKAGE_BRIDGE_OPENCDM=y
BR2_PACKAGE_BRIDGE_PLAYERINFO=y
BR2_PACKAGE_BRIDGE_PROVISIONPROXY=y
BR2_PACKAGE_PLUGIN_BLUETOOTH_PORT="/dev/ttyS1"
BR2_PACKAGE_PLUGIN_BLUETOOTHREMOTECONTROL=y
BR2_PACKAGE_PLUGIN_BLUETOOTHAUDIOSINK=y
BR2_PACKAGE_PLUGIN_BRIDGELINK=y
BR2_PACKAGE_PLUGIN_COMMANDER=y
BR2_PACKAGE_PLUGIN_COMPOSITOR=y
BR2_PACKAGE_PLUGIN_COMPOSITOR_AUTOSTART=y
BR2_PACKAGE_PLUGIN_COMPOSITOR_OUTOFPROCESS=y
BR2_PACKAGE_PLUGIN_COMPOSITOR_MESA=y
BR2_PACKAGE_PLUGIN_DIALSERVER=y
BR2_PACKAGE_PLUGIN_DICTIONARY=y
BR2_PACKAGE_PLUGIN_DEVICEINFO=y
BR2_PACKAGE_PLUGIN_DHCPSERVER=y
BR2_PACKAGE_PLUGIN_DISPLAYINFO=y
BR2_PACKAGE_PLUGIN_LAUNCHER=y
BR2_PACKAGE_PLUGIN_LOCATIONSYNC=y
BR2_PACKAGE_PLUGIN_MONITOR=y
BR2_PACKAGE_PLUGIN_NETWORKCONTROL=y
BR2_PACKAGE_PLUGIN_NETWORKCONTROL_INTERFACES="eth0;Dynamic;;;;null|wlan0;Dynamic;;;;null"
BR2_PACKAGE_PLUGIN_OPENCDMSERVER=y
BR2_PACKAGE_PLUGIN_TIMESYNC=y
BR2_PACKAGE_PLUGIN_PLAYERINFO=y
BR2_PACKAGE_PLUGIN_REMOTECONTROL=y
BR2_PACKAGE_PLUGIN_MESSAGECONTROL=y
BR2_PACKAGE_PLUGIN_WEBKITBROWSER=y
BR2_PACKAGE_PLUGIN_WEBPROXY=y
BR2_PACKAGE_PLUGIN_WEBSERVER=y
BR2_PACKAGE_PLUGIN_WEBSHELL=y
BR2_PACKAGE_PLUGIN_WIFI=y
BR2_PACKAGE_PLUGIN_BUTLER=y
BR2_PACKAGE_PLUGIN_CLOUDRELAY=y
BR2_PACKAGE_PLUGIN_I2CCONTROL=y
BR2_PACKAGE_PLUGIN_IOCONTROL=y
BR2_PACKAGE_PLUGIN_ONEWIRECONTROL=y
BR2_PACKAGE_PLUGIN_RULEENGINE=y
BR2_PACKAGE_PLUGIN_RUSTBRIDGE=y
BR2_PACKAGE_PLUGIN_SCRIPTENGINE=y
BR2_PACKAGE_PLUGIN_SPICONTROL=y
BR2_PACKAGE_PLUGIN_VIRTUALCONTROL=y
BR2_PACKAGE_PLUGIN_ZIGBEECONTROL=y
BR2_PACKAGE_ZIGBEE_PORT="/dev/ttyS3"
BR2_PACKAGE_PLUGIN_ZWAVECONTROL=y
BR2_PACKAGE_ZWAVE_PORT="/dev/ttyS2"
BR2_PACKAGE_PLUGIN_PROVISIONING=y
BR2_PACKAGE_PLUGIN_SWITCHBOARD=y
```

## addon/configs/licheepi4a_bridge_defconfig
```kconfig
BR2_riscv=y
BR2_TOOLCHAIN_BUILDROOT_VENDOR="iot"
BR2_PACKAGE_HOST_LINUX_HEADERS_CUSTOM_5_10=y
BR2_TOOLCHAIN_BUILDROOT_CXX=y
BR2_PACKAGE_HOST_GDB=y
BR2_TARGET_GENERIC_HOSTNAME="licheepi4a"
BR2_TARGET_GENERIC_ISSUE="Welcome to LicheePi 4A"
BR2_TARGET_GENERIC_GETTY_PORT="ttyS0"
BR2_ROOTFS_POST_IMAGE_SCRIPT="board/sipeed/lpi4a/post-image.sh"
BR2_LINUX_KERNEL=y
BR2_LINUX_KERNEL_CUSTOM_GIT=y
BR2_LINUX_KERNEL_CUSTOM_REPO_URL="https://github.com/revyos/thead-kernel.git"
BR2_LINUX_KERNEL_CUSTOM_REPO_VERSION="lpi4a"
BR2_LINUX_KERNEL_DEFCONFIG="revyos"
BR2_LINUX_KERNEL_DTS_SUPPORT=y
BR2_LINUX_KERNEL_INTREE_DTS_NAME="thead/light-lpi4a"
BR2_LINUX_KERNEL_INSTALL_TARGET=y
BR2_PACKAGE_GNUTLS=y
BR2_PACKAGE_OPENSSL=y
BR2_PACKAGE_DROPBEAR=y
BR2_TARGET_UBOOT=y
BR2_TARGET_UBOOT_BUILD_SYSTEM_KCONFIG=y
BR2_TARGET_UBOOT_CUSTOM_VERSION=y
BR2_TARGET_UBOOT_CUSTOM_VERSION_VALUE="2025.07"
BR2_TARGET_UBOOT_BOARD_DEFCONFIG="th1520_lpi4a"
BR2_TARGET_UBOOT_NEEDS_DTC=y
BR2_TARGET_UBOOT_NEEDS_GNUTLS=y
BR2_TARGET_UBOOT_USE_BINMAN=y
BR2_TARGET_UBOOT_CUSTOM_MAKEOPTS="BINMAN_BLOBS_DIR=${BR2_EXTERNAL_ADDON_PACKAGES_PATH}/board/licheepi4a/firmware/uboot"
BR2_PACKAGE_BRIDGE=y
BR2_PACKAGE_BRIDGE_DEVICES=y
BR2_PACKAGE_BRIDGE_ZWAVE=y
BR2_PACKAGE_BRIDGE_ZIGBEE=y
BR2_PACKAGE_BRIDGE_SECURE_SOCKETS=y
BR2_PACKAGE_BRIDGE_COMRPC_PLATFORM_DEFINITION=y
BR2_PACKAGE_BRIDGE_COMRPC_INSTANCE_64=y
BR2_PACKAGE_BRIDGE_MESSAGING=y
BR2_PACKAGE_BRIDGE_RELEASE=y
# BR2_PACKAGE_BRIDGE_DEVICEINFO is not set
BR2_PACKAGE_PLUGIN_BLUETOOTHREMOTECONTROL=y
BR2_PACKAGE_PLUGIN_BLUETOOTHAUDIOSINK=y
BR2_PACKAGE_PLUGIN_BRIDGELINK=y
BR2_PACKAGE_PLUGIN_DEVICEINFO=y
BR2_PACKAGE_PLUGIN_REMOTECONTROL=y
BR2_PACKAGE_PLUGIN_MESSAGECONTROL=y
BR2_PACKAGE_PLUGIN_BUTLER=y
BR2_PACKAGE_PLUGIN_VIRTUALCONTROL=y
BR2_PACKAGE_SIPEED_LPI4ABIN=y
```

## addon/configs/platco_tv_defconfig
```kconfig
BR2_arm=y
BR2_cortex_a53=y
BR2_ARM_FPU_NEON_FP_ARMV8=y
BR2_CCACHE=y
BR2_GLOBAL_PATCH_DIR="$(BR2_EXTERNAL_ML_CSS_PATH)/board/sky/platco/patches"
# BR2_PIC_PIE is not set
BR2_SSP_NONE=y
BR2_RELRO_NONE=y
BR2_FORTIFY_SOURCE_NONE=y
BR2_TOOLCHAIN_BUILDROOT_GLIBC=y
BR2_KERNEL_HEADERS_4_9=y
BR2_BINUTILS_VERSION_2_32_X=y
BR2_TOOLCHAIN_BUILDROOT_CXX=y
BR2_PACKAGE_HOST_GDB=y
BR2_ROOTFS_DEVICE_CREATION_DYNAMIC_MDEV=y
BR2_TARGET_GENERIC_ROOT_PASSWD="root"
BR2_SYSTEM_DHCP="eth0"
BR2_LINUX_KERNEL=y
BR2_LINUX_KERNEL_CUSTOM_GIT=y
BR2_LINUX_KERNEL_CUSTOM_REPO_URL="git@github.com:Metrological/amlogic-linux-meson.git"
BR2_LINUX_KERNEL_CUSTOM_REPO_VERSION="a52dc0dc1ba7162f0b398040c6c272882e89a79c"
BR2_LINUX_KERNEL_DEFCONFIG="platco_cad11"
BR2_LINUX_KERNEL_DTS_SUPPORT=y
BR2_LINUX_KERNEL_INTREE_DTS_NAME="amlogic/tm2_revb_t962x3_llama_drm_v13"
BR2_LINUX_KERNEL_NEEDS_HOST_OPENSSL=y
BR2_PACKAGE_GST1_PLUGINS_BAD=y
BR2_PACKAGE_BITSTREAM_VERA=y
BR2_PACKAGE_CANTARELL=y
BR2_PACKAGE_FONT_AWESOME=y
BR2_PACKAGE_LIBERATION=y
BR2_PACKAGE_FDK_AAC=y
BR2_PACKAGE_TREMOR=y
BR2_PACKAGE_CA_CERTIFICATES=y
BR2_PACKAGE_GNUTLS_TOOLS=y
BR2_PACKAGE_GRAPHITE2=y
BR2_PACKAGE_LCMS2=y
BR2_PACKAGE_LIBDRM_NOUVEAU=y
BR2_PACKAGE_LIBDRM_OMAP=y
BR2_PACKAGE_LIBDRM_FREEDRENO=y
BR2_PACKAGE_LIBDRM_VC4=y
BR2_PACKAGE_LIBDRM_INSTALL_TESTS=y
BR2_PACKAGE_LIBMNG=y
BR2_PACKAGE_LIBOPENH264=y
BR2_PACKAGE_NGHTTP2=y
BR2_PACKAGE_P11_KIT=y
BR2_PACKAGE_DROPBEAR=y
BR2_PACKAGE_WPA_SUPPLICANT=y
BR2_TARGET_ROOTFS_CPIO=y
BR2_TARGET_ROOTFS_SQUASHFS=y
BR2_PACKAGE_AMLOGIC_MALI_DRIVER=y
BR2_PACKAGE_PLATCO_TV_SDK=y
BR2_PACKAGE_PLATCO_TV_BSP=y
BR2_PACKAGE_AML_AUDIO_SERVICE=y
BR2_PACKAGE_AML_SECMEM=y
BR2_PACKAGE_GST1_AMLOGIC=y
BR2_PACKAGE_GST1_AMLOGIC_ASINK=y
BR2_PACKAGE_GST1_AMLOGIC_PCR_SINK=y
BR2_PACKAGE_WPEFRAMEWORK=y
BR2_PACKAGE_WPEFRAMEWORK_SYSTEM_PATH="/usr/lib/wpeframework/plugins"
BR2_PACKAGE_WPEFRAMEWORK_PROXYSTUB_PATH="/usr/lib/wpeframework/proxystubs"
BR2_PACKAGE_WPEFRAMEWORK_CLIENTLIBRARY_BROADCAST=y
BR2_PACKAGE_WPEFRAMEWORK_CLIENTLIBRARY_DISPLAYINFO=y
BR2_PACKAGE_WPEFRAMEWORK_CDMI_PLAYREADY_MODULE=y
BR2_PACKAGE_WPEFRAMEWORK_COMPOSITOR=y
BR2_PACKAGE_WPEFRAMEWORK_COMPOSITOR_OUTOFPROCESS=y
BR2_PACKAGE_WPEFRAMEWORK_COMPOSITOR_RESOLUTION_1080P=y
BR2_PACKAGE_WPEFRAMEWORK_LOCATIONSYNC=y
BR2_PACKAGE_WPEFRAMEWORK_LOCATIONSYNC_URI="http://jsonip.metrological.com/?maf=true"
BR2_PACKAGE_WPEFRAMEWORK_NETWORKCONTROL=y
BR2_PACKAGE_WPEFRAMEWORK_REMOTECONTROL=y
BR2_PACKAGE_WPEFRAMEWORK_TIMESYNC=y
BR2_PACKAGE_WPEFRAMEWORK_TRACECONTROL=y
BR2_PACKAGE_WPEFRAMEWORK_WEBKITBROWSER=y
BR2_PACKAGE_WPEFRAMEWORK_WEBSERVER=y
WPEFRAMEWORK_RDKSERVICES_SITE_WEBPLATFORMFOREMBEDDED=y
BR2_PACKAGE_WESTEROS=y
```

## addon/configs/raspberrypi0_bridge_defconfig
```kconfig
BR2_arm=y
BR2_arm1176jzf_s=y
BR2_TOOLCHAIN_BUILDROOT_VENDOR="domotica"
BR2_PACKAGE_HOST_LINUX_HEADERS_CUSTOM_6_6=y
BR2_TOOLCHAIN_BUILDROOT_CXX=y
BR2_PACKAGE_HOST_GDB=y
BR2_CCACHE=y
BR2_CCACHE_DIR="$(BASE_DIR)/ccache"
BR2_GLOBAL_PATCH_DIR="${BR2_EXTERNAL_ADDON_PACKAGES_PATH}/patches"
BR2_FORTIFY_SOURCE_NONE=y
BR2_TARGET_GENERIC_HOSTNAME="Domotica"
BR2_TARGET_GENERIC_ISSUE="Welcome to Domotica"
BR2_TARGET_GENERIC_ROOT_PASSWD="root"
BR2_TARGET_GENERIC_GETTY_PORT="ttyAMA0"
BR2_ROOTFS_POST_BUILD_SCRIPT="${BR2_EXTERNAL_ADDON_PACKAGES_PATH}/board/raspberrypi0/post-build.sh"
BR2_ROOTFS_POST_IMAGE_SCRIPT="board/raspberrypi0/post-image.sh  "
BR2_ROOTFS_POST_SCRIPT_ARGS="--i2c --spi --1w --tvmode-720 --overclock-pi012 --silent"
BR2_LINUX_KERNEL=y
BR2_LINUX_KERNEL_CUSTOM_GIT=y
BR2_LINUX_KERNEL_CUSTOM_REPO_URL="https://github.com/raspberrypi/linux.git"
BR2_LINUX_KERNEL_CUSTOM_REPO_VERSION="rpi-6.6.y"
BR2_LINUX_KERNEL_USE_CUSTOM_CONFIG=y
BR2_LINUX_KERNEL_CUSTOM_CONFIG_FILE="${BR2_EXTERNAL_ADDON_PACKAGES_PATH}/board/raspberrypi/rpi0123-linux-6.6.config"
BR2_LINUX_KERNEL_DTS_SUPPORT=y
BR2_LINUX_KERNEL_INTREE_DTS_NAME="broadcom/bcm2708-rpi-b-plus broadcom/bcm2708-rpi-zero-w broadcom/bcm2708-rpi-zero broadcom/bcm2708-rpi-b broadcom/bcm2708-rpi-cm"
BR2_PACKAGE_FAAD2=y
BR2_PACKAGE_GST1_PLUGINS_BAD_PLUGIN_DEBUGUTILS=y
BR2_PACKAGE_BITSTREAM_VERA=y
BR2_PACKAGE_BRCMFMAC_SDIO_FIRMWARE_RPI=y
BR2_PACKAGE_RPI_FIRMWARE=y
BR2_PACKAGE_RPI_FIRMWARE_BOOTCODE_BIN=y
BR2_PACKAGE_RPI_FIRMWARE_VARIANT_PI=y
BR2_PACKAGE_RPI_FIRMWARE_CONFIG_FILE="board/raspberrypi/config_0w.txt"
BR2_PACKAGE_RPI_USERLAND=y
BR2_PACKAGE_ALSA_LIB=y
BR2_PACKAGE_OPUS=y
BR2_PACKAGE_SBC=y
BR2_PACKAGE_TREMOR=y
BR2_PACKAGE_CA_CERTIFICATES=y
BR2_PACKAGE_GRAPHITE2=y
BR2_PACKAGE_JPEG_TURBO=y
BR2_PACKAGE_LIBMNG=y
BR2_PACKAGE_MTDEV=y
BR2_PACKAGE_LIBEVDEV=y
BR2_PACKAGE_ORC=y
BR2_PACKAGE_DROPBEAR=y
BR2_PACKAGE_GESFTPSERVER=y
BR2_PACKAGE_KMOD=y
BR2_TARGET_ROOTFS_EXT2=y
BR2_TARGET_ROOTFS_EXT2_4=y
BR2_TARGET_ROOTFS_EXT2_SIZE="512M"
# BR2_TARGET_ROOTFS_TAR is not set
BR2_PACKAGE_HOST_GENIMAGE=y
BR2_PACKAGE_HOST_MTOOLS=y
BR2_PACKAGE_WPEWEBKIT_ML=y
BR2_PACKAGE_PLAYREADY4=y
BR2_PACKAGE_BRIDGE_TOOLS=y
BR2_PACKAGE_BRIDGE=y
BR2_PACKAGE_BRIDGE_MESSAGING=y
BR2_PACKAGE_BRIDGE_COMPOSITORCLIENT=y
BR2_PACKAGE_BRIDGE_PROVISIONPROXY=y
BR2_PACKAGE_BRIDGE_OPENCDM=y
BR2_PACKAGE_BRIDGE_DISPLAYINFO=y
BR2_PACKAGE_BRIDGE_PLAYERINFO=y
BR2_PACKAGE_BRIDGE_CRYPTOGRAPHY=y
BR2_PACKAGE_PLUGIN_BRIDGELINK=y
BR2_PACKAGE_PLUGIN_COMMANDER=y
BR2_PACKAGE_PLUGIN_COMPOSITOR=y
BR2_PACKAGE_PLUGIN_DIALSERVER=y
BR2_PACKAGE_PLUGIN_DICTIONARY=y
BR2_PACKAGE_PLUGIN_DEVICEINFO=y
BR2_PACKAGE_PLUGIN_DHCPSERVER=y
BR2_PACKAGE_PLUGIN_DISPLAYINFO=y
BR2_PACKAGE_PLUGIN_LAUNCHER=y
BR2_PACKAGE_PLUGIN_LOCATIONSYNC=y
BR2_PACKAGE_PLUGIN_LOCATIONSYNC_URI="http://jsonip.metrological.com/?maf=true"
BR2_PACKAGE_PLUGIN_MONITOR=y
BR2_PACKAGE_PLUGIN_NETWORKCONTROL=y
BR2_PACKAGE_PLUGIN_OPENCDMSERVER=y
BR2_PACKAGE_CDMI_CLEARKEY=y
BR2_PACKAGE_CDMI_PLAYREADY=y
BR2_PACKAGE_PLUGIN_TIMESYNC=y
BR2_PACKAGE_PLUGIN_REMOTECONTROL=y
BR2_PACKAGE_PLUGIN_SNAPSHOT=y
BR2_PACKAGE_PLUGIN_MESSAGECONTROL=y
BR2_PACKAGE_PLUGIN_WEBKITBROWSER=y
BR2_PACKAGE_PLUGIN_WEBPROXY=y
BR2_PACKAGE_PLUGIN_WEBSERVER=y
BR2_PACKAGE_PLUGIN_WEBSHELL=y
BR2_PACKAGE_PLUGIN_WIFI=y
BR2_PACKAGE_PLUGIN_RPCLINK=y
BR2_PACKAGE_PLUGIN_BUTLER=y
BR2_PACKAGE_PLUGIN_I2CCONTROL=y
BR2_PACKAGE_PLUGIN_IOCONTROL=y
BR2_PACKAGE_PLUGIN_ONEWIRECONTROL=y
BR2_PACKAGE_PLUGIN_RULEENGINE=y
BR2_PACKAGE_PLUGIN_SPICONTROL=y
BR2_PACKAGE_PLUGIN_VIRTUALCONTROL=y
BR2_PACKAGE_PLUGIN_ZIGBEECONTROL=y
BR2_PACKAGE_ZIGBEE_PORT="/dev/ttyAMA1"
BR2_PACKAGE_PLUGIN_ZWAVECONTROL=y
BR2_PACKAGE_ZWAVE_PORT="/dev/ttyAMA2"
BR2_PACKAGE_PLUGIN_PROVISIONING=y
BR2_PACKAGE_BRIDGE_UI=y
```
