/dts-v1/;
/plugin/;

/ {
    model = "Banana Pi BPI-M2-Zero";
    compatible = "sinovoip,bpi-m2-zero\0allwinner,sun8i-h2-plus";

    /* 
     * enable onboard eth0 on Banana PI M2 ZERO
     * which is disabled by default
     * bontango 08.2022
     *
     * compile with
     * dtc -I dts -O dtb -o bananapi-m2-zero-eth0.dtbo bananapi-m2-zero-eth0.dts 
     * move bananapi-m2-zero-eth0.dtbo to /boot/overlay-user
     * add line "user_overlays=bananapi-m2-zero-eth0" to /boot/armbianEnv.txt    
     */
    fragment@0 {
        target-path = "/aliases";
        __overlay__ {
            ethernet0 = "/soc/ethernet@1c30000";
        };
    };
    
    fragment@1 {
        target = <&emac>;
        __overlay__ {
            status = "okay";
            phy-handle = <&int_mii_phy>;
            phy-mode = "mii";
            allwinner,leds-active-low;
        };
    };
};
